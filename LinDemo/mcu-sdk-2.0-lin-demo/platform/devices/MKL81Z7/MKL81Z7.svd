# MKL81Z7 register map
Vendor: Freescale Semiconductor, Inc.; Series: Kinetis_L; File version: 1.6
MKL81Z7 Freescale Microcontroller
CPU: CM0PLUS r0p0, little endian, no MPU, no FPU, VTOR, 2 interrupt priority bits
Registers are 32-bit, read-write, reset 0x0 unless marked. A register's access mark holds for its fields unless they carry their own. Offsets are from the block's base; lines under a group give offsets from that group; [hi:lo] are bit positions; {n}, {i} and the like mark numbered series; 'fields as' and 'values as' point back to an identical list; <NAME> marks a mode.

## Memory map
0x00000400 FTFA_FlashConfig size 0xE — Flash configuration field
0x40000000 AIPS size 0x70 — AIPS-Lite Bridge
0x40008000 DMA size 0x1100 — Enhanced direct memory access controller
0x4000D000 MPU size 0x820 — Memory protection unit
0x40020000 FTFA size 0x2C — Flash Memory Interface
0x40021000 DMAMUX size 0x8 — DMA channel multiplexor
0x40024000 INTMUX0 size 0xE4 — Interrupt Multiplexer
0x40025000 TRNG0 size 0xF8
0x4002C000 SPI0 size 0x8C — Serial Peripheral Interface
0x4002D000 SPI1 size 0x8C — Serial Peripheral Interface
0x40032000 CRC size 0xC — Cyclic Redundancy Check
0x40037000 PIT0 size 0x140 — Periodic Interrupt Timer
0x40038000 TPM0 size 0x88 — Timer/PWM Module
0x40039000 TPM1 size 0x88 — Timer/PWM Module
0x4003A000 TPM2 size 0x88 — Timer/PWM Module
0x4003B000 ADC0 size 0x70 — Analog-to-Digital Converter
0x4003D000 RTC size 0x808 — Secure Real Time Clock
0x4003E000 RFVBAT size 0x20 — VBAT register file
0x4003F000 DAC0 size 0x24 — 12-Bit Digital-to-Analog Converter
0x40040000 LPTMR0 size 0x10 — Low Power Timer
0x40041000 RFSYS size 0x20 — System register file
0x40042000 DRY blocks up to offset 0x1808 — Tamper Detect and Secure Key Storage
0x40044000 LPTMR1 size 0x10 — Low Power Timer
0x40045000 TSI0 size 0xC — Touch sense input
0x40047000 SIM size 0x10A0 — System Integration Module
0x40049000 PORTA size 0xA4 — Pin Control and Interrupts
0x4004A000 PORTB size 0xA4 — Pin Control and Interrupts
0x4004B000 PORTC size 0xA4 — Pin Control and Interrupts
0x4004C000 PORTD size 0xA4 — Pin Control and Interrupts
0x4004D000 PORTE size 0xA4 — Pin Control and Interrupts
0x4004E000 EMVSIM0 size 0x4C — EMVSIM
0x4004F000 EMVSIM1 size 0x4C — EMVSIM
0x40051000 LTC0 size 0xF00 — LTC
0x40052000 WDOG size 0x18 — Generation 2008 Watchdog Timer
0x40054000 LPUART0 size 0x20 — Universal Asynchronous Receiver/Transmitter
0x40055000 LPUART1 size 0x20 — Universal Asynchronous Receiver/Transmitter
0x40056000 LPUART2 size 0x20 — Universal Asynchronous Receiver/Transmitter
0x4005A000 QuadSPI0 size 0x410 — QuadSPI
0x4005F000 FLEXIO0 size 0x7A0 — The FLEXIO Memory Map/Register Definition can be found here.
0x40061000 EWM size 0x6 — External Watchdog Monitor
0x40064000 MCG size 0xE — Multipurpose Clock Generator module
0x40065000 OSC size 0x3 — Oscillator
0x40066000 I2C0 size 0xD — Inter-Integrated Circuit
0x40067000 I2C1 size 0xD — Inter-Integrated Circuit
0x40072000 USB0 size 0x15D — Universal Serial Bus, OTG Capable Controller
0x40073000 CMP0 size 0x6 — High-Speed Comparator (CMP), Voltage Reference (VREF) Digital-to-Analog Converter (DAC), and Analog Mux (ANMUX)
0x40074000 VREF size 0x2 — Voltage Reference
0x4007C000 LLWU size 0x12 — Low leakage wakeup unit
0x4007D000 PMC size 0xC — Power Management Controller
0x4007E000 SMC size 0x4 — System Mode Controller
0x4007F000 RCM size 0xA — Reset Control Module
0x400FF000 GPIOA size 0x18 — General Purpose Input/Output
0x400FF040 GPIOB size 0x18 — General Purpose Input/Output
0x400FF080 GPIOC size 0x18 — General Purpose Input/Output
0x400FF0C0 GPIOD size 0x18 — General Purpose Input/Output
0x400FF100 GPIOE size 0x18 — General Purpose Input/Output
0xF0000000 MTB size 0x1000 — Micro Trace Buffer
0xF0001000 MTBDWT size 0x1000 — MTB data watchpoint and trace
0xF0002000 ROM size 0x1000 — System ROM
0xF0003000 MCM blocks up to offset 0x44 — Core Platform Miscellaneous Control Module
0xF8000000 FGPIOA size 0x18 — General Purpose Input/Output
0xF8000040 FGPIOB size 0x18 — General Purpose Input/Output
0xF8000080 FGPIOC size 0x18 — General Purpose Input/Output
0xF80000C0 FGPIOD size 0x18 — General Purpose Input/Output
0xF8000100 FGPIOE size 0x18 — General Purpose Input/Output

## Interrupts
0 DMA0_DMA4 (DMA)
1 DMA1_DMA5 (DMA)
2 DMA2_DMA6 (DMA)
3 DMA3_DMA7 (DMA)
4 DMA_Error (DMA)
5 FLEXIO0
6 TPM0
7 TPM1
8 TPM2
9 PIT0
10 SPI0
11 EMVSIM0
12 LPUART0
13 LPUART1
14 I2C0
15 QSPI0 (QuadSPI0)
16 Tamper (DRY)
17 PORTA (PORTA, GPIOA)
18 PORTB (PORTB, GPIOB)
19 PORTC (PORTC, GPIOC)
20 PORTD (PORTD, GPIOD)
21 PORTE (PORTE, GPIOE)
22 LLWU
23 LTC0
24 USB0
25 ADC0
26 LPTMR0
27 RTC_Seconds (RTC)
28 INTMUX0_0 (INTMUX0)
29 INTMUX0_1 (INTMUX0)
30 INTMUX0_2 (INTMUX0)
31 INTMUX0_3 (INTMUX0)
32 LPTMR1 (INTMUX0, LPTMR1)
36 SPI1 (INTMUX0, SPI1)
37 LPUART2 (INTMUX0, LPUART2)
38 EMVSIM1 (INTMUX0, EMVSIM1)
39 I2C1 (INTMUX0, I2C1)
40 TSI0 (INTMUX0, TSI0)
41 PMC (INTMUX0, PMC)
42 FTFA (FTFA, INTMUX0)
43 MCG (INTMUX0, MCG)
44 WDOG_EWM (INTMUX0, WDOG, EWM)
45 DAC0 (INTMUX0, DAC0)
46 TRNG0 (INTMUX0, TRNG0)
48 CMP0 (INTMUX0, CMP0)
50 RTC_Alarm (INTMUX0, RTC)
56 DMA4 (INTMUX0)
57 DMA5 (INTMUX0)
58 DMA6 (INTMUX0)
59 DMA7 (INTMUX0)

## Licence text in the file
Redistribution and use in source and binary forms, with or without modification, are permitted provided that the following conditions are met: o Redistributions of source code must retain the above copyright notice, this list of conditions and the following disclaimer. o Redistributions in binary form must reproduce the above copyright notice, this list of conditions and the following disclaimer in the documentation and/or other materials provided with the distribution. o Neither the name of Freescale Semiconductor, Inc. nor the names of its contributors may be used to endorse or promote products derived from this software without specific prior written permission. THIS SOFTWARE IS PROVIDED BY THE COPYRIGHT HOLDERS AND CONTRIBUTORS "AS IS" AND. ANY EXPRESS OR IMPLIED WARRANTIES, INCLUDING, BUT NOT LIMITED TO, THE IMPLIED. WARRANTIES OF MERCHANTABILITY AND FITNESS FOR A PARTICULAR PURPOSE ARE. DISCLAIMED. IN NO EVENT SHALL THE COPYRIGHT HOLDER OR CONTRIBUTORS BE LIABLE FOR. ANY DIRECT, INDIRECT, INCIDENTAL, SPECIAL, EXEMPLARY, OR CONSEQUENTIAL DAMAGES (INCLUDING, BUT NOT LIMITED TO, PROCUREMENT OF SUBSTITUTE GOODS OR SERVICES; LOSS OF USE, DATA, OR PROFITS; OR BUSINESS INTERRUPTION) HOWEVER CAUSED AND ON. ANY THEORY OF LIABILITY, WHETHER IN CONTRACT, STRICT LIABILITY, OR TORT (INCLUDING NEGLIGENCE OR OTHERWISE) ARISING IN ANY WAY OUT OF THE USE OF THIS. SOFTWARE, EVEN IF ADVISED OF THE POSSIBILITY OF SUCH DAMAGE.
